#include <SPI.h>
#include <Gamebuino.h>

//Font variables

//-------------------------------------

Gamebuino gb;
extern const byte font5x7[];

//-------------------------------------
//Stuff from magpi
#define W LCDWIDTH
#define H LCDHEIGHT

#define PAD_U 0x01
#define PAD_D 0x02
#define PAD_L 0x04
#define PAD_R 0x08
#define PAD_A 0x10
#define PAD_B 0x20
#define PAD_C 0x40

byte px,py;
boolean pd;

byte kc;

byte flash_color = 0;

//-------------------------------------
//define images
const byte logo[] PROGMEM= {
  84, 48,
  0x00,0x00,0x00,0x00,0x00,0x00,0x00,0x00,0x00,0x00,0x00,
  0x7F,0x03,0xF8,0x01,0xC0,0xE3,0x03,0xF8,0x3F,0x80,0x00,
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  0x00,0x00,0x00,0x3F,0xC0,0x00,0x00,0x00,0x00,0x00,0x00,
};

//------------------------------------------------------------------------------
//Canvas
byte canvas[530] = {
    84, 48
};

void paintPixel(byte x, byte y) {
	int b = 2 + (y * 11) + (x/8);
	canvas[b] |= 0x80 >> x%8;
}

void myDrawBitmap(byte x, byte y, byte *bitmap) {
	byte xb = *(bitmap++);
	byte yb = *(bitmap++);
	byte rows = yb;
	byte columns = xb/8 + ((xb%8) ? 1 : 0);
	byte row,column,b;
	for(row=0;row<rows;row++) {
		for(column=0;column<columns;column++) {
			for(b=0;b<8;b++) {
				if ((0x80 >> b) & *bitmap ) gb.display.drawPixel(column*8+b,row);
			}
			bitmap++;
		}
	}
}

//------------------------------------------------------------------------------
//Menus
////declare all the variables needed to make a menu

//number of items in the menu
#define MAINMENULENGTH 5
#define SETTINGSMENULENGTH 2
#define CONFIRMMENULENGTH 2

//The different strings to put in the menu
//each string can be used in different menus
const char strSettings[] PROGMEM = "Settings";
const char strClear[] PROGMEM = "Clear";
const char strSave[] PROGMEM = "Save";
const char strExport[] PROGMEM = "Export";
const char strQuit[] PROGMEM = "Quit";

//Confirm clear
const char strClearYes[] PROGMEM = "Yes, Clear";
const char strClearNo[] PROGMEM = "No, Cancel";

//Within settings
const char strPenSize[] PROGMEM = "Pen Size";
const char strEraserSize[] PROGMEM = "Eraser Size";


//Put all the different items together in a menu (an array of strings actually)
const char* const mainmenu[MAINMENULENGTH] PROGMEM = {
	strSettings,
	strClear,
	strSave,
  	strExport,
	strQuit,
};

const char* const settingsmenu[SETTINGSMENULENGTH] PROGMEM = {
	strPenSize,
	strEraserSize,
};

const char* const clearmenu[CONFIRMMENULENGTH] PROGMEM = {
	strClearYes,
	strClearNo,
};

void doMenus(){
	
	boolean done = false;
	
	while(!done){
		switch(gb.menu(mainmenu, MAINMENULENGTH)){
 				
 		  case 0: //Settings
 			
 		  	switch(gb.menu(settingsmenu, SETTINGSMENULENGTH)){
 					 					
 		    	  case 0: //Pen Size
 				  	//FIXME
				    done = true;
 		        	break;
 					
 		    	  case 1: //Eraser Size
 				  	//FIXME
			    	done = true;
 		        	break;

 		  	}
 		   	break;
 				
 		  case 1: //Clear
		  	switch(gb.menu(clearmenu, CONFIRMMENULENGTH)){
 			case 0: //doClear
 				//FIXME
		    	done = true;
 				break;
 				}
 			break;
 			case 2: //Save
 			   	//FIXME
				done = true;
 			    break;
 				
 			case 3: //Export
 			   	//FIXME
				done = true;
 			    break;
 				
 			case 4: //Quit
 				setup();
				done = true;
 			    break;
				
			default:
				done = true;
				break;
 			
 			}
 		}
}

//------------------------------------------------------------------------------
#define FRAMES_PER_SECOND 20

boolean any_button_pressed() {
	if(gb.buttons.pressed(BTN_A|BTN_B|BTN_C|BTN_LEFT|BTN_RIGHT|BTN_UP|BTN_DOWN)){
		return true;
	}
}

void doKC() {
	gb.backlight.automatic = false;
  	gb.backlight.set(0);
	delay(200);
	gb.backlight.set(255);
	delay(200);
  	gb.backlight.set(0);
  	delay(200);  
  	gb.backlight.set(255);
  	delay(200);
  	gb.backlight.set(0);
  	delay(200);
  	gb.backlight.set(255);
  	delay(200);
  	gb.backlight.set(0);
  	delay(200);
  	gb.backlight.set(255);
  	delay(200);
  	gb.backlight.set(0);
  	delay(200);
	gb.backlight.automatic = true;
}

//------------------------------------------------------------------------------
void setup()
{
    gb.begin();
    gb.display.setFont(font5x7);
    gb.titleScreen(F(""), logo);
	
	gb.display.persistence = true;
    gb.battery.show = true;
	gb.setFrameRate(20);
    gb.display.clear();
	
    gb.pickRandomSeed();
	
    kc = 0;
    px = W/2;
    py = H/2;
    pd = false;
}

//------------------------------------------------------------------------------
void loop()
{
    if(gb.update()) {
		myDrawBitmap(0, 0, canvas);
	  if (!pd){ //if pen up
	  	if(!(gb.frameCount % 5)) { //Note: (!(gb.frameCount % 5)) means (gb.frameCount % 5 == 0)
		  flash_color = !(flash_color);
	    }
		gb.display.setColor(flash_color);
	    gb.display.drawPixel(px,py);
	  }
	  
	  //if(this-is-so-I-can minimize-this-section-of-code-in-TextMate){
      // <DO NOT TRY TO FIGURE OUT WHAT THIS CODE DOES!>	  
      boolean done = 0;
      if(gb.buttons.pressed(BTN_UP) && ((kc == 0) || (kc == 1))) {
        kc++;
        done = 1;
      }
      if(gb.buttons.pressed(BTN_DOWN) && ((kc == 2) || (kc == 3))) {
        kc++;
        done = 1;
      }
      if(gb.buttons.pressed(BTN_LEFT) && ((kc == 4) || (kc == 6))) {
        kc++;
        done = 1;
      }
      if(gb.buttons.pressed(BTN_RIGHT) && ((kc == 5) || (kc == 7))) {
        kc++;
        done = 1;
      }
      if(gb.buttons.pressed(BTN_B) && (kc == 8)) {
        kc++; 
        done = 1;
      }
      if(gb.buttons.pressed(BTN_A) && (kc == 9)) {
        kc++;
        done = 1;
      }
      if(gb.buttons.pressed(BTN_C) && (kc == 10)) {
        kc++;
        done = 1;
      }
      if(done != 1) kc = 0;
      if(kc == 11) doKC();
      // </DO NOT TRY TO FIGURE OUT WHAT THIS CODE DOES!>
  	  //}
	  
      if(gb.buttons.pressed(BTN_LEFT)) {
      	if(px == 0) px=W-1; //move left
        else px--;
	  }
      if(gb.buttons.pressed(BTN_RIGHT)) {
        if(px == W-1) px=0; //move right
        else px++;
	  }
      if(gb.buttons.pressed(BTN_DOWN)) {
        if (py == H-1) py=0; //move down
        else py++;
	  }
      if(gb.buttons.pressed(BTN_UP)) {
        if(py == 0) py=H-1; //move up
        else py--;
	  }
      if(gb.buttons.pressed(BTN_A)) {
        pd = pd ? false : true; //toggle pen down
	  }
      if(gb.buttons.pressed(BTN_B)) {
        if(!pd) p_state = 0;
	  }
      if(pd) {
   	   	paintPixel(px,py);
      }
	  if(gb.buttons.pressed(BTN_C)) {
		  doMenus();
      }

  }	
}
